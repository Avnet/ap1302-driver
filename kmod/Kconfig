## kmod/Kconfig
```kconfig
config VIDEO_AP1302
	tristate "AP1302 external ISP support"
	depends on I2C && VIDEO_V4L2
	select REGMAP_I2C
	help
		This is a Video4Linux2 sensor-level driver for the external
		ISP AP1302.

		AP1302 is an external ISP.

		It only supports very limited feature
```
